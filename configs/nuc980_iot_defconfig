## configs/nuc980_iot_defconfig
```kconfig
CONFIG_ARM=y
CONFIG_TARGET_NUC980_IOT=y
CONFIG_SYS_TEXT_BASE=0xE00000
CONFIG_NR_DRAM_BANKS=2
CONFIG_SPL=y
CONFIG_SMBIOS_PRODUCT_NAME=""
CONFIG_SPL_TEXT_BASE=0x200
CONFIG_BOOTSTAGE_STASH_SIZE=4096
CONFIG_BOOTDELAY=3
CONFIG_SYS_CONSOLE_OVERWRITE_ROUTINE=y
CONFIG_HUSH_PARSER=y
# CONFIG_CMD_FLASH is not set
CONFIG_CMD_NAND=y
# CONFIG_CMD_SETEXPR is not set
CONFIG_CMD_TIMER=y
CONFIG_NAND_NUC980=y
CONFIG_NUC980_CONSOLE=y
CONFIG_OF_LIBFDT=y
CONFIG_SMBIOS_MANUFACTURER=""
```

## drivers/mtd/nand/Kconfig
```kconfig
config MTD_NAND_CORE
	tristate

config NAND_NUC970
	bool "NUC970/N9H30 NAND support"
	depends on NUC970

config NAND_NUC980
	bool "NUC980 NAND support"
	depends on NUC980

source "drivers/mtd/nand/raw/Kconfig"

source "drivers/mtd/nand/spi/Kconfig"
```
